## basic/main/Kconfig.projbuild
```kconfig
menu "Application Configuration"

	choice DIRECTION
		prompt "Communication polarity"
		default SENDER
		help
			Select Communication polarity.
		config SENDER
			bool "As the sender"
			help
				As the sender.
		config RECEIVER
			bool "As the receiver"
			help
				As the receiver.
	endchoice

endmenu 
```

## components/ra01s/Kconfig.projbuild
```kconfig
menu "SX126X Configuration"

	config GPIO_RANGE_MAX
		int
		default 33 if IDF_TARGET_ESP32
		default 46 if IDF_TARGET_ESP32S2
		default 48 if IDF_TARGET_ESP32S3
		default 18 if IDF_TARGET_ESP32C2
		default 19 if IDF_TARGET_ESP32C3
		default 30 if IDF_TARGET_ESP32C6

	choice FREQUENCY
		prompt "Frequency to use"
		default 433MHZ
		help
			Select Frequency to use.
		config 433MHZ
			bool "433MHz"
			help
				Frequency is 433MHz.
		config 866MHZ
			bool "866MHz"
			help
				Frequency is 866MHz.
		config 915MHZ
			bool "915MHz"
			help
				Frequency is 915MHz.
		config OTHER
			bool "Other"
			help
				Other Frequency.
	endchoice

	config OTHER_FREQUENCY
		depends on OTHER
		int "Frequency to use[MHz]"
		range 1 999
		default 433
		help
			Frequency to use[MHz].

	config ADVANCED
		bool "Enable Advanced settings"
		default false
		help
			Enable Advanced settings.

	config CODING_RATE
		depends on ADVANCED
		int "Error coding rate"
		range 1 4
		default 1
		help
			Error coding rate.

	config BANDWIDTH
		depends on ADVANCED
		int "Signal Bandwidth"
		range 0 6
		default 4
		help
			Signal Bandwidth.

	config SF_RATE
		depends on ADVANCED
		int "Spreading Factor"
		range 5 12
		default 7
		help
			Spreading Factor.

	config USE_TCXO
		bool "Enable TCXO"
		default false
		help
			Enable Temperature-Compensated Crystal Oscillator.

	config MISO_GPIO
		int "SX126X MISO GPIO"
		range 0 GPIO_RANGE_MAX
		default 19 if IDF_TARGET_ESP32
		default 37 if IDF_TARGET_ESP32S2 || IDF_TARGET_ESP32S3
		default  4 # C3 and others
		help
			Pin Number to be used as the MISO SPI signal.

	config SCLK_GPIO
		int "SX126X SCLK GPIO"
		range 0 GPIO_RANGE_MAX
		default 18 if IDF_TARGET_ESP32
		default 36 if IDF_TARGET_ESP32S2 || IDF_TARGET_ESP32S3
		default  5 # C3 and others
		help
			Pin Number to be used as the SCLK SPI signal.

	config MOSI_GPIO
		int "SX126X MOSI GPIO"
		range 0 GPIO_RANGE_MAX
		default 23 if IDF_TARGET_ESP32
		default 35 if IDF_TARGET_ESP32S2 || IDF_TARGET_ESP32S3
		default  6 # C3 and others
		help
			Pin Number to be used as the MOSI SPI signal.

	config NSS_GPIO
		int "SX126X NSS GPIO"
		range 0 GPIO_RANGE_MAX
		default 15 if IDF_TARGET_ESP32
		default 34 if IDF_TARGET_ESP32S2 || IDF_TARGET_ESP32S3
		default  7 # C3 and others
		help
			Pin Number to be used as the NSS SPI signal.

	config RST_GPIO
		int "SX126X RST GPIO"
		range 0 GPIO_RANGE_MAX
		default 16 if IDF_TARGET_ESP32
		default 38 if IDF_TARGET_ESP32S2 || IDF_TARGET_ESP32S3
		default  2 # C3 and others
		help
			Pin Number to be used as the RST signal.

	config BUSY_GPIO
		int "SX126X BUSY GPIO"
		range 0 GPIO_RANGE_MAX
		default 17 if IDF_TARGET_ESP32
		default 39 if IDF_TARGET_ESP32S2 || IDF_TARGET_ESP32S3
		default  3 # C3 and others
		help
			Pin Number to be used as the BUSY signal.

	config TXEN_GPIO
		int "SX126X TXEN GPIO"
		range -1 GPIO_RANGE_MAX
		default -1
		help
			Pin Number to be used as the TXEN signal.

	config RXEN_GPIO
		int "SX126X RXEN GPIO"
		range -1 GPIO_RANGE_MAX
		default -1
		help
			Pin Number to be used as the RXEN signal.

	choice SPI_HOST
		prompt "SPI peripheral that controls this bus"
		default SPI2_HOST
		help
			Select SPI peripheral that controls this bus.
		config SPI2_HOST
			bool "SPI2_HOST"
			help
				Use SPI2_HOST. This is also called HSPI_HOST.
		config SPI3_HOST
			depends on IDF_TARGET_ESP32 || IDF_TARGET_ESP32S2 || IDF_TARGET_ESP32S3
			bool "SPI3_HOST"
			help
				USE SPI3_HOST. This is also called VSPI_HOST
	endchoice

endmenu
```

## interrupt/main/Kconfig.projbuild
```kconfig
menu "Application Configuration"

	choice DIRECTION
		prompt "Communication polarity"
		default SENDER
		help
			Select Communication polarity.
		config SENDER
			bool "As the sender"
			help
				As the sender.
		config RECEIVER
			bool "As the receiver"
			help
				As the receiver.
	endchoice

	config INPUT_GPIO
		int "INPUT GPIO"
		range 0 GPIO_RANGE_MAX
		default 21 if IDF_TARGET_ESP32
		default  1 if IDF_TARGET_ESP32S2 || IDF_TARGET_ESP32S3
		default  1 # C3 and others
		help
			Pin Number to be used as the INPUT signal.

endmenu 
```

## mqtt/main/Kconfig.projbuild
```kconfig
menu "Application Configuration"

	menu "WiFi Setting"

		config ESP_WIFI_SSID
			string "WiFi SSID"
			default "myssid"
			help
				SSID (network name) for the example to connect to.

		config ESP_WIFI_PASSWORD
			string "WiFi Password"
			default "mypassword"
			help
				WiFi password (WPA or WPA2) for the example to use.

		config ESP_MAXIMUM_RETRY
			int "Maximum retry"
			default 5
			help
				Set the Maximum retry to avoid station reconnecting to the AP unlimited when the AP is really inexistent.

	endmenu

	menu "Radio Setting"

		choice DIRECTION
			prompt "Communication polarity"
			default SENDER
			help
				Select Communication polarity.
			config SENDER
				bool "MQTT to LoRa"
				help
					MQTT to LoRa.
			config RECEIVER
				bool "LoRa to MQTT"
				help
					LoRa to MQTT.
		endchoice

	endmenu

	menu "Broker Setting"

		choice MQTT_TRANSPORT
			prompt "MQTT Transport"
			default MQTT_TRANSPORT_OVER_TCP
			help
				Select MQTT Transport.
			config MQTT_TRANSPORT_OVER_TCP
				bool "Using Over TCP"
				help
					Using Over TCP
			config MQTT_TRANSPORT_OVER_SSL
				bool "Using over SSL"
				help
					Using over SSL
			config MQTT_TRANSPORT_OVER_WS
				bool "Using over WS"
				help
					Using over WS
			config MQTT_TRANSPORT_OVER_WSS
				bool "Using over WSS"
				help
					Using over WSS
		endchoice

		config MQTT_BROKER
			string "MQTT Broker"
			default "broker.emqx.io"
			help
				Host name or IP address of the broker to connect to

		config MQTT_PORT_TCP
			depends on MQTT_TRANSPORT_OVER_TCP
			int "MQTT Port"
			range 0 65535
			default 1883
			help
				Port number of the broker to connect to.

		config MQTT_PORT_SSL
			depends on MQTT_TRANSPORT_OVER_SSL
			int "MQTT Port"
			range 0 65535
			default 8883
			help
				Port number of the broker to connect to.

		config MQTT_PORT_WS
			depends on MQTT_TRANSPORT_OVER_WS
			int "MQTT Port"
			range 0 65535
			default 8083
			help
				Port number of the broker to connect to.

		config MQTT_PORT_WSS
			depends on MQTT_TRANSPORT_OVER_WSS
			int "MQTT Port"
			range 0 65535
			default 8084
			help
				Port number of the broker to connect to.

		choice MQTT_PROTOCOL
			prompt "MQTT Protocol"
			default MQTT_PROTOCOL_V_3_1_1
			help
				Select Protocol.
			config MQTT_PROTOCOL_V_3_1_1
				bool "PROTOCOL_V_3_1_1"
				help
					PROTOCOL_V_3_1_1
			config MQTT_PROTOCOL_V_5
				bool "PROTOCOL_V_5"
				help
					PROTOCOL_V_5.
		endchoice

		config MQTT_PUB_TOPIC
			depends on RECEIVER
			string "Publish Topic"
			default "/topic/lora/test"
			help
				Topic of publish

		config MQTT_SUB_TOPIC
			depends on SENDER
			string "Subscribe Topic"
			default "/topic/lora/test"
			help
				Topic of subscribe

		config BROKER_AUTHENTICATION
			bool "Server requests for password when connecting"
			default false
			help
				Server requests for password when connecting.

		config AUTHENTICATION_USERNAME
			depends on BROKER_AUTHENTICATION
			string "Username used for connecting to the broker"
			default "user"
			help
				Username used for connecting to the broker.

		config AUTHENTICATION_PASSWORD
			depends on BROKER_AUTHENTICATION
			string "Password used for connecting to the broker"
			default "password"
			help
				Username used for connecting to the broker.

	endmenu

endmenu 
```

## ping-pong/main/Kconfig.projbuild
```kconfig
menu "Application Configuration"

	choice POLARITY
		prompt "Communication Polarity"
		default PRIMARY
		help
			Select Communication Polarity.
		config PRIMARY
			bool "Primary"
			help
				As Echo Client.
		config SECONDARY
			bool "Secondary"
			help
				As Echo Server.
	endchoice

endmenu 
```

## tcp-socket/main/Kconfig.projbuild
```kconfig
menu "Application Configuration"

	menu "WiFi Setting"

	config ESP_WIFI_SSID
		string "WiFi SSID"
		default "myssid"
		help
			SSID (network name) for the example to connect to.

	config ESP_WIFI_PASSWORD
		string "WiFi Password"
		default "mypassword"
		help
			WiFi password (WPA or WPA2) for the example to use.

	config ESP_MAXIMUM_RETRY
		int "Maximum retry"
		default 5
		help
			Set the Maximum retry to avoid station reconnecting to the AP unlimited when the AP is really inexistent.

	config MDNS_HOSTNAME
		string "mDNS Hostname"
		default "esp32-server"
		help
			The mDNS host name used by the ESP32.

	endmenu

	menu "Radio Setting"

	choice DIRECTION
		prompt "Communication polarity"
		default SENDER
		help
			Select Communication polarity.
		config SENDER
			bool "TCP to LoRa"
			help
				TCP to LoRa.
		config RECEIVER
			bool "LoRa to TCP"
			help
				LoRa to TCP
	endchoice

	config TCP_HOST
		depends on RECEIVER
		string "TCP Host"
		default "tcp-server.local"
		help
			IP4 address or mDNS hostname of the remote host.

	config TCP_PORT
		int "TCP Port"
		range 0 65535
		default 8080
		help
			TCP port number.

	endmenu

endmenu 
```

## tusb-serial/main/Kconfig.projbuild
```kconfig
menu "Application Configuration"

	choice DIRECTION
		prompt "Communication polarity"
		default SENDER
		help
			Select Communication polarity.
		config SENDER
			bool "USB to LoRa"
			help
				USB to LoRa.
		config RECEIVER
			bool "LoRa to USB"
			help
				LoRa to USB.
	endchoice

endmenu 
```

## udp-socket/main/Kconfig.projbuild
```kconfig
menu "Application Configuration"

	menu "WiFi Setting"

	config ESP_WIFI_SSID
		string "WiFi SSID"
		default "myssid"
		help
			SSID (network name) for the example to connect to.

	config ESP_WIFI_PASSWORD
		string "WiFi Password"
		default "mypassword"
		help
			WiFi password (WPA or WPA2) for the example to use.

	config ESP_MAXIMUM_RETRY
		int "Maximum retry"
		default 5
		help
			Set the Maximum retry to avoid station reconnecting to the AP unlimited when the AP is really inexistent.

	config MDNS_HOSTNAME
		string "mDNS Hostname"
		default "esp32-server"
		help
			The mDNS host name used by the ESP32.

	endmenu

	menu "Radio Setting"

	choice DIRECTION
		prompt "Communication polarity"
		default SENDER
		help
			Select Communication polarity.
		config SENDER
			bool "UDP to LoRa"
			help
				UDP to LoRa.
		config RECEIVER
			bool "LoRa to UDP"
			help
				LoRa to UDP.
	endchoice

    choice UDP_ADDRESS
		depends on RECEIVER
        bool "Select UDP Addrss"
        default UDP_LIMITED_BROADCAST
        help
            Select Send Addrss.
        config UDP_LIMITED_BROADCAST
            bool "Limited broadcast address"
        config UDP_DIRECTED_BROADCAST
            bool "Directed broadcast address"
        config UDP_MULTICAST
            bool "Multicast address"
        config UDP_UNICAST
            bool "Unicast address"
    endchoice

    config UDP_MULTICAST_ADDRESS
        depends on UDP_MULTICAST
        string "Multicast address"
        default "239.255.255.255"

    config UDP_UNICAST_ADDRESS
        depends on UDP_UNICAST
        string "Unicast address"
        default "192.168.10.20"

	config UDP_PORT
		int "UDP Port"
		range 0 65535
		default 8080
		help
			UDP port number.

	endmenu

endmenu 
```

## vcp/main/Kconfig.projbuild
```kconfig
menu "Application Configuration"

	menu "Radio Setting"

		choice DIRECTION
			prompt "Communication polarity"
			default SENDER
			help
				Select Communication polarity.
			config SENDER
				bool "VCP to LoRa"
				help
					VCP to LoRa.
			config RECEIVER
				bool "LoRa to VCP"
				help
					LoRa to VCP.
		endchoice

	endmenu

	menu "VCP Setting"

		config VCP_BAUDRATE
			int "VCP communication speed"
			range 1200 115200
			default 115200
			help
				VCP communication speed.

		config VCP_STOP_BITS
			int "VCP communication stop bits"
			range 0 2
			default 0
			help
				VCP communication stop bits. 0: 1 stopbit, 1: 1.5 stopbits, 2: 2 stopbits

		config VCP_PARITY
			int "VCP communication parity"
			range 0 4
			default 0
			help
				VCP communication parity. 0: None, 1: Odd, 2: Even, 3: Mark, 4: Space

		config VCP_DATA_BITS
			int "VCP communication data bits"
			default 8
			help
				VCP communication data bits.

	endmenu

endmenu 
```

## vcp/sdkconfig.defaults
```kconfig
#
# Compiler options
#
CONFIG_COMPILER_CXX_EXCEPTIONS=y
CONFIG_USB_HOST_HUBS_SUPPORTED=y
```

## ws/main/Kconfig.projbuild
```kconfig
menu "Application Configuration"

	menu "WiFi Setting"

		config ESP_WIFI_SSID
			string "WiFi SSID"
			default "myssid"
			help
				SSID (network name) for the example to connect to.

		config ESP_WIFI_PASSWORD
			string "WiFi Password"
			default "mypassword"
			help
				WiFi password (WPA or WPA2) for the example to use.

		config ESP_MAXIMUM_RETRY
			int "Maximum retry"
			default 5
			help
				Set the Maximum retry to avoid station reconnecting to the AP unlimited when the AP is really inexistent.

		config MDNS_HOSTNAME
			string "mDNS Hostname"
			default "esp32-server"
			help
				The mDNS host name used by the ESP32.

	endmenu

	menu "Radio Setting"

		choice DIRECTION
			prompt "Communication polarity"
			default SENDER
			help
				Select Communication polarity.
			config SENDER
				bool "WS to LoRa"
				help
					WS to LoRa.
			config RECEIVER
				bool "LoRa to WS"
				help
					LoRa to WS.
		endchoice

		config WEB_SERVER_HOST
			depends on RECEIVER
			string "server to connect to"
			default "http-server.local"
			help
				server to connect to.

		config WEB_SERVER_PORT
			depends on RECEIVER
			int "port to connect to"
			default 8080
			help
				port to connect to.

		config WEB_LISTEN_PORT
			depends on SENDER
			int "Listening port"
			default 8080
			help
				Listening port.

	endmenu

endmenu 
```
